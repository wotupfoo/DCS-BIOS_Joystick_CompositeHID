// Generated by Google Gemini 3/7/2026
// https://share.google/aimode/YOotV3tVjnLzdAGhL
/*  prompts:
    [use stm32f1 and OpenComposite]
    6 analog axes pa0..5 on joystick1
    4 analog axes pa6..9 on joystick2
    4 rotary encoders using pb0..7 sending up and down button press on joystick1
    2 buttons using portC on joystick2 all remaining digital
*/

/* Some errors in the generated code. Joystick2 isn't instantiated, and the rotary encoders 
are not fully implemented. Here's a corrected version:*/

#include <USBComposite.h>
#include <RotaryEncoder.h>

// --- Config ---
const int numEnc = 4;
const int encPins[numEnc][2] = {{PB0, PB1}, {PB2, PB3}, {PB4, PB5}, {PB6, PB7}};
const int btnPins[2] = {PC13, PC14};
const unsigned long pulseWidth = 30; // ms button press duration

// --- Objects ---
USBHID HID;
HIDJoystick Joystick1(HID);
HIDJoystick Joystick2(HID);
RotaryEncoder* encoders[numEnc];

// Timing for non-blocking button pulses
unsigned long buttonReleaseTime[numEnc * 2] = {0}; 

// ISRs (one per encoder)
void checkEnc0() { encoders[0]->tick(); }
void checkEnc1() { encoders[1]->tick(); }
void checkEnc2() { encoders[2]->tick(); }
void checkEnc3() { encoders[3]->tick(); }
void (*isrFuncs[])() = {checkEnc0, checkEnc1, checkEnc2, checkEnc3};

void setup() {
  HID.begin(HID_JOYSTICK);
  HID.registerComponent(Joystick1);
  HID.registerComponent(Joystick2);

  while (!USBComposite);
  Joystick1.setManualReportMode(true);
  Joystick2.setManualReportMode(true);

  // Setup Analog Axes (PA0-PA9)
  for (int i = 0; i <= 9; i++) pinMode(PA0 + i, INPUT_ANALOG);

  // Setup Encoders
  for (int i = 0; i < numEnc; i++) {
    encoders[i] = new RotaryEncoder(encPins[i][0], encPins[i][1], RotaryEncoder::LatchMode::FOUR0);
    pinMode(encPins[i][0], INPUT_PULLUP);
    pinMode(encPins[i][1], INPUT_PULLUP);
    attachInterrupt(digitalPinToInterrupt(encPins[i][0]), isrFuncs[i], CHANGE);
    attachInterrupt(digitalPinToInterrupt(encPins[i][1]), isrFuncs[i], CHANGE);
  }

  // Setup PC Buttons
  for (int i = 0; i < 2; i++) pinMode(btnPins[i], INPUT_PULLUP);
}

void loop() {
  unsigned long now = millis();

  // 1. ANALOG AXES (Smooth update every loop)
  Joystick1.X(analogRead(PA0) << 4); // Scaled for joystick resolution
  Joystick1.Y(analogRead(PA1) << 4);
  Joystick1.Z(analogRead(PA2) << 4);
  Joystick1.Xrot(analogRead(PA3) << 4);
  Joystick1.Yrot(analogRead(PA4) << 4);
  Joystick1.Zrot(analogRead(PA5) << 4);

  Joystick2.X(analogRead(PA6) << 4);
  Joystick2.Y(analogRead(PA7) << 4);
  Joystick2.Z(analogRead(PA8) << 4);
  Joystick2.Xrot(analogRead(PA9) << 4);

  // 2. ENCODER ROTATION (Trigger button press)
  static long lastPos[numEnc] = {0};
  for (int i = 0; i < numEnc; i++) {
    long newPos = encoders[i]->getPosition();
    if (newPos != lastPos[i]) {
      int btnIdx = (newPos > lastPos[i]) ? (i * 2) : (i * 2 + 1);
      
      Joystick1.button(btnIdx + 1, true);
      buttonReleaseTime[btnIdx] = now + pulseWidth; // Schedule release
      lastPos[i] = newPos;
    }
  }

  // 3. NON-BLOCKING RELEASE (Check if pulse is over)
  for (int b = 0; b < (numEnc * 2); b++) {
    if (buttonReleaseTime[b] != 0 && now >= buttonReleaseTime[b]) {
      Joystick1.button(b + 1, false);
      buttonReleaseTime[b] = 0;
    }
  }

  // 4. PORT C BUTTONS (Direct mapping)
  Joystick2.button(1, !digitalRead(PC13));
  Joystick2.button(2, !digitalRead(PC14));

  // 5. SEND HID REPORT
  Joystick1.send_now();
  Joystick2.send_now();
}
